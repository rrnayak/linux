// SPDX-License-Identifier: BSD-3-Clause
// Copyright (c) 2019, The Linux Foundation. All rights reserved.

#include <dt-bindings/interrupt-controller/irq.h>
#include <dt-bindings/spmi/spmi.h>

&spmi_bus {
	pm6150l_lsid4: pmic@4 {
		compatible = "qcom,pm6150l", "qcom,spmi-pmic";
		reg = <0x4 SPMI_USID>;
		#address-cells = <1>;
		#size-cells = <0>;

		pm6150l_gpios: gpios@c000 {
			compatible = "qcom,pm6150l-gpio", "qcom,spmi-gpio";
			reg = <0xc000 0xc00>;
			gpio-controller;
			#gpio-cells = <2>;
			interrupts = <4 0xc0 0 IRQ_TYPE_NONE>,
				     <4 0xc1 0 IRQ_TYPE_NONE>,
				     <4 0xc2 0 IRQ_TYPE_NONE>,
				     <4 0xc3 0 IRQ_TYPE_NONE>,
				     <4 0xc4 0 IRQ_TYPE_NONE>,
				     <4 0xc5 0 IRQ_TYPE_NONE>,
				     <4 0xc6 0 IRQ_TYPE_NONE>,
				     <4 0xc7 0 IRQ_TYPE_NONE>,
				     <4 0xc8 0 IRQ_TYPE_NONE>,
				     <4 0xc9 0 IRQ_TYPE_NONE>,
				     <4 0xca 0 IRQ_TYPE_NONE>,
				     <4 0xcb 0 IRQ_TYPE_NONE>;

			interrupt-names = "pm6150l_gpio1", "pm6150l_gpio2",
					"pm6150l_gpio3", "pm6150l_gpio4",
					"pm6150l_gpio5", "pm6150l_gpio6",
					"pm6150l_gpio7", "pm6150l_gpio8",
					"pm6150l_gpio9", "pm6150l_gpio10",
					"pm6150l_gpio11", "pm6150l_gpio12";
		};
	};

	pm6150l_lsid5: pmic@5 {
		compatible = "qcom,pm6150l", "qcom,spmi-pmic";
		reg = <0x5 SPMI_USID>;
		#address-cells = <1>;
		#size-cells = <0>;
	};
};
