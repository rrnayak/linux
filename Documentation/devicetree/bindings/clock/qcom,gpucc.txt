## drivers/gpu/drm/msm/Kconfig
```kconfig
config DRM_MSM
	tristate "MSM DRM"
	depends on DRM
	depends on ARCH_QCOM || (ARM && COMPILE_TEST)
	depends on OF && COMMON_CLK
	depends on MMU
	select QCOM_MDT_LOADER if ARCH_QCOM
	select REGULATOR
	select DRM_KMS_HELPER
	select DRM_PANEL
	select SHMEM
	select TMPFS
	select QCOM_SCM
	select WANT_DEV_COREDUMP
	select SND_SOC_HDMI_CODEC if SND_SOC
	select SYNC_FILE
	select HDCP_QSEECOM
	select MSM_EXT_DISPLAY
	default y
	help
	  DRM/KMS driver for MSM/snapdragon.

config DRM_MSM_REGISTER_LOGGING
	bool "MSM DRM register logging"
	depends on DRM_MSM
	default n
	help
	  Compile in support for logging register reads/writes in a format
	  that can be parsed by envytools demsm tool.  If enabled, register
	  logging can be switched on via msm.reglog=y module param.

config DRM_MSM_GPU_SUDO
	bool "Enable SUDO flag on submits"
	depends on DRM_MSM && EXPERT
	default n
	help
	  Enable userspace that has CAP_SYS_RAWIO to submit GPU commands
	  that are run from RB instead of IB1.  This essentially gives
	  userspace kernel level access, but is useful for firmware
	  debugging.

	  Only use this if you are a driver developer.  This should *not*
	  be enabled for production kernels.  If unsure, say N.

config DRM_MSM_HDMI_HDCP
	bool "Enable HDMI HDCP support in MSM DRM driver"
	depends on DRM_MSM && QCOM_SCM
	default n
	help
	  Compile in support for logging register reads/writes in a format
	  that can be parsed by envytools demsm tool.  If enabled, register
	  logging can be switched on via msm.reglog=y module param.

config DRM_MSM_HDMI
	bool "Enable HDMI support in MSM DRM driver"
	depends on DRM_MSM
	default n
	help
	  Compile in support for HDMI driver in msm drm
	  driver. HDMI external display support is enabled
	  through this config option. It can be primary or
	  secondary display on device.

config DRM_MSM_DSI
	bool "Enable DSI support in MSM DRM driver"
	depends on DRM_MSM
	select DRM_PANEL
	select DRM_MIPI_DSI
	default n
	help
	  Choose this option if you have a need for MIPI DSI connector
	  support.

config DRM_MSM_DSI_STAGING
	bool "Enable new DSI driver support in MSM DRM driver"
	depends on DRM_MSM
	select DRM_PANEL
	select DRM_MIPI_DSI
	default y
	help
	  Choose this option if you need MIPI DSI connector support on MSM
	  which conforms to DRM. MIPI stands for Mobile Industry Processor
	  Interface and DSI stands for Display Serial Interface which powers
	  the primary display of your mobile device.

config DRM_MSM_DSI_PLL
	bool "Enable DSI PLL driver in MSM DRM"
	depends on DRM_MSM_DSI && COMMON_CLK
	default y
	help
	  Choose this option to enable DSI PLL driver which provides DSI
	  source clocks under common clock framework.

config DRM_MSM_DSI_28NM_PHY
	bool "Enable DSI 28nm PHY driver in MSM DRM"
	depends on DRM_MSM_DSI
	default y
	help
	  Choose this option if the 28nm DSI PHY is used on the platform.

config DRM_MSM_DSI_20NM_PHY
	bool "Enable DSI 20nm PHY driver in MSM DRM"
	depends on DRM_MSM_DSI
	default y
	help
	  Choose this option if the 20nm DSI PHY is used on the platform.

config DRM_MSM_DSI_28NM_8960_PHY
	bool "Enable DSI 28nm 8960 PHY driver in MSM DRM"
	depends on DRM_MSM_DSI
	default y
	help
	  Choose this option if the 28nm DSI PHY 8960 variant is used on the
	  platform.

config DRM_MSM_DPU
	tristate "MSM DPU DRM driver"
	depends on DRM_MSM
	default y
	help
	  Choose this option if MSM DPU revision support is
	  needed in DRM/KMS. DPU supports DSI and DP displays.


config DRM_MSM_MDP5
	tristate "MSM MDP5 DRM driver"
	depends on DRM_MSM
	default n
	help
	  Choose this option if MSM MDP5 revision support is
	  needed in DRM/KMS. This is not required if dpu/mdp4
	  only target enabled. MDP5 supports DSI and HDMI
	  displays.

config DRM_MSM_MDP4
	tristate "MSM MDP4 DRM driver"
	depends on DRM_MSM
	default n
	help
	  Choose this option if MSM MDP4 revision support is needed in DRM/KMS.
	  MSM MDP4 DRM driver should be disabled for other MDP revisions to
	  avoid possible conflicts.  Only select this option if the target
	  MSM platform is MDP4 based.

config DRM_MSM_DSI_14NM_PHY
	bool "Enable DSI 14nm PHY driver in MSM DRM (used by MSM8996/APQ8096)"
	depends on DRM_MSM_DSI
	default y
	help
	  Choose this option if DSI PHY on 8996 is used on the platform.

config DRM_MSM_DSI_10NM_PHY
	bool "Enable DSI 10nm PHY driver in MSM DRM (used by SDM845)"
	depends on DRM_MSM_DSI
	default y
	help
	  Choose this option if DSI PHY on SDM845 is used on the platform.

config DRM_DPU_EVTLOG_DEBUG
	bool "Enable event logging in MSM DRM"
	depends on DRM_MSM
	help
	  The DPU DRM debugging provides support to enable display debugging
	  features to: dump DPU registers during driver errors, panic
	  driver during fatal errors and enable some display-driver logging
	  into an internal buffer (this avoids logging overhead).

config DRM_DPU_RSC
	bool "Enable dpu resource state coordinator(rsc) driver"
	depends on DRM_MSM
	help
	  The DPU DRM RSC provides display Resource State Coordinator support
	  to vote the ab/ib bandwidth for primary display. Each rsc client
	  can vote their active state. Any active request from any client
	  avoids the display core power collapse. A client can also register
	  for display core power collapse events on rsc.
```

## drivers/net/ipa/Kconfig
```kconfig
config IPA
	tristate "Qualcomm IPA support"
	depends on NET && QCOM_QMI_HELPERS
	default n
	help
	  Choose Y here to include support for the Qualcomm IP
	  Accelerator (IPA), a hardware block present in some
	  Qualcomm SoCs.  The IPA is a programmable protocol
	  processor that is capable of generic hardware handling
	  of IP packets, including routing, filtering, and NAT.
	  Currently the IPA driver supports only basic transport
	  of network traffic between the AP and modem, on the
	  Qualcomm SDM845 SoC.

	  If unsure, say N.

config IPA_ASSERT
	bool "Enable IPA assertions"
	depends on IPA
	default y
	help
	 Incorporate IPA assertion verification in the build.  This
	 cause various design assumptions to be checked at runtime,
	 generating a report (and a crash) if any assumed condition
	 does not hold.  You may wish to disable this to avoid the
	 overhead of checking.

	 If unsure doubt, say "Y" here.
```
