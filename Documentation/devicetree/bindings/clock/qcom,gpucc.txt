## Documentation/devicetree/bindings/clock/qcom,gpucc.txt
```
Qualcomm Graphics Clock & Reset Controller Binding
--------------------------------------------------

Required properties :
- compatible : shall contain "qcom,sdm845-gpucc".
- reg : shall contain base register location and length.
- #clock-cells : from common clock binding, shall contain 1.
- #reset-cells : from common reset binding, shall contain 1.
- #power-domain-cells : from generic power domain binding, shall contain 1.

Example:
	gpucc: clock-controller@@5090000 {
		compatible = "qcom,sdm845-gpucc";
		reg = <0x5090000 0x9000>;
		#clock-cells = <1>;
		#reset-cells = <1>;
		#power-domain-cells = <1>;
	};
```

## Documentation/devicetree/bindings/clock/qcom,gpucc.yaml
```yaml
# SPDX-License-Identifier: GPL-2.0-only
%YAML 1.2
---
$id: http://devicetree.org/schemas/bindings/clock/qcom,gpucc.yaml#
$schema: http://devicetree.org/meta-schemas/core.yaml#

title: Qualcomm Graphics Clock & Reset Controller Binding

maintainers:
  - Taniya Das <tdas@codeaurora.org>

description: |
  Qualcomm grpahics clock control module which supports the clocks, resets and
  power domains.

properties:
  compatible:
    enum:
      - qcom,sdm845-gpucc
      - qcom,msm8998-gpucc

  clocks:
    minItems: 1
    maxItems: 2
    items:
      - description: Board XO source
      - description: GPLL0 source from GCC

  clock-names:
    minItems: 1
    maxItems: 2
    items:
      - const: xo
      - const: gpll0

  '#clock-cells':
    const: 1

  '#reset-cells':
    const: 1

  '#power-domain-cells':
    const: 1

  reg:
    maxItems: 1

required:
  - compatible
  - reg
  - clocks
  - clock-names
  - '#clock-cells'
  - '#reset-cells'
  - '#power-domain-cells'

examples:
  # Example of GPUCC with clock node properties for SDM845:
  - |
    clock-controller@5090000 {
      compatible = "qcom,sdm845-gpucc";
      reg = <0x5090000 0x9000>;
      clocks = <&rpmhcc 0>, <&gcc 32>;
      clock-names = "xo", "gpll0";
      #clock-cells = <1>;
      #reset-cells = <1>;
      #power-domain-cells = <1>;
     };
...
```

## Documentation/devicetree/bindings/clock/qcom,mss.txt
```
QTI MSS Clock Controller Binding
--------------------------------

Required properties :
- compatible : shall contain "qcom,sc7180-mss"
- #clock-cells: from common clock binding, shall contain 1.
- reg : shall contain base register address and size, in the order.

optional properties :
- reg-names : register names of MSS domain
		"cc".

Example:

	mss: clock-controller@41aa000 {
		compatible = "qcom,sc7180-mss";
		reg = <0x041aa000 0x100>;
		reg-names = "cc";
		#clock-cells = <1>;
	};
```

## Documentation/devicetree/bindings/cpufreq/cpufreq-qcom-hw.txt
```
Qualcomm Technologies, Inc. CPUFREQ Bindings

CPUFREQ HW is a hardware engine used by some Qualcomm Technologies, Inc. (QTI)
SoCs to manage frequency in hardware. It is capable of controlling frequency
for multiple clusters.

Properties:
- compatible
	Usage:		required
	Value type:	<string>
	Definition:	must be "qcom,cpufreq-hw".

- clocks
	Usage:		required
	Value type:	<phandle> From common clock binding.
	Definition:	clock handle for XO clock.

- clock-names
	Usage:		required
	Value type:	<string> From common clock binding.
	Definition:	must be "xo".

* Property qcom,freq-domain
Devices supporting freq-domain must set their "qcom,freq-domain" property with
phandle to a freq_domain_table in their DT node.

* Frequency Domain Table Node

This describes the frequency domain belonging to a device.
This node can have following properties:

- reg
	Usage:		required
	Value type:	<prop-encoded-array>
	Definition:	Addresses and sizes for the memory of the HW bases.

Example:

Example 1: Dual-cluster, Quad-core per cluster. CPUs within a cluster switch
DCVS state together.

/ {
	cpus {
		#address-cells = <2>;
		#size-cells = <0>;

		CPU0: cpu@0 {
			device_type = "cpu";
			compatible = "qcom,kryo385";
			reg = <0x0 0x0>;
			enable-method = "psci";
			next-level-cache = <&L2_0>;
			qcom,freq-domain = <&freq_domain_table0>;
			L2_0: l2-cache {
				compatible = "cache";
				next-level-cache = <&L3_0>;
				L3_0: l3-cache {
				      compatible = "cache";
				};
			};
		};

		CPU1: cpu@100 {
			device_type = "cpu";
			compatible = "qcom,kryo385";
			reg = <0x0 0x100>;
			enable-method = "psci";
			next-level-cache = <&L2_100>;
			qcom,freq-domain = <&freq_domain_table0>;
			L2_100: l2-cache {
				compatible = "cache";
				next-level-cache = <&L3_0>;
			};
		};

		CPU2: cpu@200 {
			device_type = "cpu";
			compatible = "qcom,kryo385";
			reg = <0x0 0x200>;
			enable-method = "psci";
			next-level-cache = <&L2_200>;
			qcom,freq-domain = <&freq_domain_table0>;
			L2_200: l2-cache {
				compatible = "cache";
				next-level-cache = <&L3_0>;
			};
		};

		CPU3: cpu@300 {
			device_type = "cpu";
			compatible = "qcom,kryo385";
			reg = <0x0 0x300>;
			enable-method = "psci";
			next-level-cache = <&L2_300>;
			qcom,freq-domain = <&freq_domain_table0>;
			L2_300: l2-cache {
				compatible = "cache";
				next-level-cache = <&L3_0>;
			};
		};

		CPU4: cpu@400 {
			device_type = "cpu";
			compatible = "qcom,kryo385";
			reg = <0x0 0x400>;
			enable-method = "psci";
			next-level-cache = <&L2_400>;
			qcom,freq-domain = <&freq_domain_table1>;
			L2_400: l2-cache {
				compatible = "cache";
				next-level-cache = <&L3_0>;
			};
		};

		CPU5: cpu@500 {
			device_type = "cpu";
			compatible = "qcom,kryo385";
			reg = <0x0 0x500>;
			enable-method = "psci";
			next-level-cache = <&L2_500>;
			qcom,freq-domain = <&freq_domain_table1>;
			L2_500: l2-cache {
				compatible = "cache";
				next-level-cache = <&L3_0>;
			};
		};

		CPU6: cpu@600 {
			device_type = "cpu";
			compatible = "qcom,kryo385";
			reg = <0x0 0x600>;
			enable-method = "psci";
			next-level-cache = <&L2_600>;
			qcom,freq-domain = <&freq_domain_table1>;
			L2_600: l2-cache {
				compatible = "cache";
				next-level-cache = <&L3_0>;
			};
		};

		CPU7: cpu@700 {
			device_type = "cpu";
			compatible = "qcom,kryo385";
			reg = <0x0 0x700>;
			enable-method = "psci";
			next-level-cache = <&L2_700>;
			qcom,freq-domain = <&freq_domain_table1>;
			L2_700: l2-cache {
				compatible = "cache";
				next-level-cache = <&L3_0>;
			};
		};
	};

	qcom,cpufreq-hw {
		compatible = "qcom,cpufreq-hw";

		clocks = <&rpmhcc RPMH_CXO_CLK>;
		clock-names = "xo";

		#address-cells = <2>;
		#size-cells = <2>;
		ranges;
		freq_domain_table0: freq_table0 {
			reg = <0 0x17d43000 0 0x1400>;
		};

		freq_domain_table1: freq_table1 {
			reg = <0 0x17d45800 0 0x1400>;
		};
	};
};
```

## Documentation/devicetree/bindings/display/msm/gpu.txt
```
Qualcomm adreno/snapdragon GPU

Required properties:
- compatible: "qcom,adreno-XYZ.W", "qcom,adreno"
    for example: "qcom,adreno-306.0", "qcom,adreno"
  Note that you need to list the less specific "qcom,adreno" (since this
  is what the device is matched on), in addition to the more specific
  with the chip-id.
- reg: Physical base address and length of the controller's registers.
- interrupts: The interrupt signal from the gpu.

Optional properties.
- clocks: device clocks. Required for a3xx, a4xx and a5xx targets. a6xx and
  newer with a GMU attached do not have direct clock control from the CPU and
  do not need to provide clock properties.
  See ../clocks/clock-bindings.txt for details.
- clock-names: the following clocks can be provided:
  * "core"
  * "iface"
  * "mem_iface"
- qcom,gmu: For a6xx and newer targets a phandle to the GMU device that will
  control the power for the GPU

Example:

/ {
	...

	gpu: qcom,kgsl-3d0@4300000 {
		compatible = "qcom,adreno-320.2", "qcom,adreno";
		reg = <0x04300000 0x20000>;
		reg-names = "kgsl_3d0_reg_memory";
		interrupts = <GIC_SPI 80 0>;
		interrupt-names = "kgsl_3d0_irq";
		clock-names =
		    "core",
		    "iface",
		    "mem_iface";
		clocks =
		    <&mmcc GFX3D_CLK>,
		    <&mmcc GFX3D_AHB_CLK>,
		    <&mmcc MMSS_IMEM_AHB_CLK>;
	};

	gpu: qcom,kgsl-3d0@5000000 {
		compatible = "qcom,adreno-630.2", "qcom,adreno";
		reg = <0x5000000 0x40000>;
		reg-names = "kgsl_3d0_reg_memory";
		interrupts = <0 300 0>;
		interrupt-names = "kgsl_3d0_irq";
	};
};
```

## Documentation/devicetree/bindings/display/truly,nt35597.txt
```
Truly model NT35597 1440x2560 DSI Panel

Required properties:
- compatible: should be "truly,nt35597"
- vdda-supply: phandle of the regulator that provides the supply voltage
  Power IC supply
- vdispp-supply: phandle of the regulator that provides the supply voltage
  for positive LCD bias
- vdispn-supply: phandle of the regulator that provides the supply voltage
  for negative LCD bias
- reset-gpios: phandle of gpio for reset line
  This should be 8mA, gpio can be configured using mux, pinctrl, pinctrl-names
- mode-gpios: phandle of the gpio for choosing the mode of the display
  for single DSI or Dual DSI
  This should be low for dual DSI and high for single DSI mode
- display-timings: Node for the Panel timings

Example:

	dsi@ae94000 {
		panel@0 {
			compatible = "truly,nt35597";
			reg = <0>;
			vdda-supply = <&pm8998_l14>;
			vdispp-supply = <&lab_regulator>;
			vdispn-supply = <&ibb_regulator>;
			pinctrl-names = "default", "suspend";
			pinctrl-0 = <&sde_dsi_active>;
			pinctrl-1 = <&sde_dsi_suspend>;

			reset-gpios = <&tlmm 6 0>;
			mode-gpios = <&tlmm 52 0>;
			display-timings {
				timing0: timing-0 {
					clock-frequency = <268316138>;
					hactive = <1440>;
					vactive = <2560>;
					hfront-porch = <200>;
					hback-porch = <64>;
					hsync-len = <32>;
					vfront-porch = <8>;
					vback-porch = <7>;
					vsync-len = <1>;
				};
			};
		};
	};
```

## Documentation/devicetree/bindings/power/reset/msm-poweroff.txt
```
MSM Restart Driver

A power supply hold (ps-hold) bit is set to power the msm chipsets.
Clearing that bit allows us to restart/poweroff. The difference
between poweroff and restart is determined by unique power manager IC
settings.

Required Properties:
-compatible: "qcom,pshold"
-reg: Specifies the physical address of the ps-hold register
Optional Properties:
-qcom,dload-mode: phandle to the TCSR hardware block and offset of the
		 download mode control register

Example:

	restart@fc4ab000 {
		compatible = "qcom,pshold";
		reg = <0xfc4ab000 0x4>;
	};
```

## Documentation/devicetree/bindings/regulator/qcom-labibb-regulator.txt
```
Qualcomm's LAB(LCD AMOLED BOOST)/IBB(Inverting Buck-Boost) Regulator

LAB can be used as a standalone positive boost power supply for general purpose
applications. IBB can be used as a standalone negative power supply for general
applications. Also, LAB and IBB can be used together to provide power supply for
display panels.

Main node required properties:

- compatible:			Must be "qcom,lab-ibb-regulator"
- #address-cells:		Must be 1
- #size-cells:			Must be 0

LAB subnode required properties:

- reg:				Specifies the SPMI address.
- reg-names:			Register names. Must be "lab".
- regulator-name:		A string used to describe the regulator.

IBB subnode required properties:

- reg:				Specifies the SPMI address.
- reg-names:			Register names. Must be "ibb".
- regulator-name:		A string used to describe the regulator.

Example:
	pmi8998_lsid1: pmic@3 {
		qcom-labibb-regulator {
			compatible = "qcom,lab-ibb-regulator";
			#address-cells = <1>;
			#size-cells = <0>;

			lab_regulator: qcom,lab@de00 {
				reg = <0xde00>;
				reg-names = "lab";
				regulator-name = "lab_reg";
			};

			ibb_regulator: qcom,ibb@dc00 {
				reg = <0xdc00>;
				reg-names = "ibb";
				regulator-name = "ibb_reg";
			};

		};
	};
```

## Documentation/devicetree/bindings/spi/qcom,spi-qcom-qspi.txt
```
QTI [Qualcomm Technologies Inc] Quad Serial Peripheral Interface (QSPI)

QSPI [Quad Serial Peripheral Interface] allows single dual and quad read/write
access to slaves. QTI's QSPI controller implements the QSPI protocol to interface
with slaves like NOR Flash devices.

Required properties:
- compatible:	Should contain:
		"qcom,qspi-v1"
- reg:		Contains the base register location and length
- interrupts:	Interrupt number used by the controller.
- clocks:	Contains the core and AHB clock names.
- clock-names:	"core" for core clock and "iface" for AHB clock.
- spi-max-frequency:	Maximum SPI core clock frequency in Hz.

SPI slave nodes must be children of the SPI master node and can contain
properties described in Documentation/devicetree/bindings/spi/spi-bus.txt

Example:

	qspi: qspi@7418000 {
		compatible = "qcom,qspi-v1";
		#address-cells = <1>;
		#size-cells = <0>;
		reg = <0x7418000 0x600>;
		interrupts = <0 459 0>;
		clock-names = "iface", "core";
		clocks = <&clock_gcc clk_gcc_qspi_ahb_clk>,
			 <&clock_gcc clk_gcc_qspi_ser_clk>;

		device@0 {
			compatible = "dummy_device";
			reg = <x>; /* CS for the device */
			spi-max-frequency = <f>; /* Max supported frequency of the slave (Hz) */
		};
	};
```
